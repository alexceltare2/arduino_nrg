#include<HardwareSerial.h>
//#define RFCHANNEL        0       // Let's use channel 0
//#define SYNCWORD1        0xB5    // Synchronization word, high byte
//#define SYNCWORD0        0x47    // Synchronization word, low byte
//#define SOURCE_ADDR      7       // Sender address
//#define PACKET_SIZE      9       // Size of packet in bytes (ADDR + DATA1 +...)
//#define DESTINATION_ADDR 

CCPACKET txPacket;  // Transmitting packet object
uint8_t main_addr = 254; //panstamp.core.getShortUID();
uint8_t data_rec[8];
uint8_t destination_t;
bool flag;
const uint8_t ledPin = LED;
uint8_t x, rssi_t, lqi_t, length_t;
bool crc_t;
int i;


  
void setup()
{
  // Setup LED output pin
  pinMode(LED_GREEN, OUTPUT);
  digitalWrite(LED_GREEN, LOW);
  pinMode(ledPin, OUTPUT);

  //panstamp.init(CFREQ_868); //obsolete, change panstamp.h
  //panstamp.radio.setCarrierFreq(CFREQ_868);
//  panstamp.radio.setChannel(RFCHANNEL);
//  panstamp.radio.setSyncWord(SYNCWORD1, SYNCWORD0);
//  panstamp.radio.setDevAddress(main_addr);
  panstamp.radio.setCCregs();
  //panstamp.setLowTxPower();

  // Let's disable address check for the current project so that our device
  // will receive packets even not addressed to it.
  //panstamp.radio.enableAddressCheck();

  // Declare RF callback function
  panstamp.setPacketRxCallback(rfPacketReceived);
  panstamp.radio.sendData(txPacket); //Necessarily dummy send packet
}

void loop()
{
digitalWrite(LED_GREEN, LOW);
 if(flag == 1){
  digitalWrite(LED_GREEN, HIGH);
   Serial.begin(9600);
   Serial.print("Data: ");
   Serial.print("(");if(destination_t<=9){Serial.print("0");}Serial.print(destination_t,HEX);Serial.print(") ");
   PrintHex8(data_rec,length_t-1);
   //Serial.println("");
   Serial.print("|CRC: ");Serial.print(crc_t);Serial.print(" ");
   Serial.print("|RSSI: ");Serial.print(rssi_t);Serial.print(" ");
   Serial.print("|LQI: ");Serial.print(lqi_t);Serial.print(" ");
   Serial.print("|Length: ");Serial.print(length_t);Serial.println("");
   Serial.end();
  clear_buffer();
  flag = 0;
  //delay(100);
  digitalWrite(LED_GREEN, LOW);
  }
}

void rfPacketReceived(CCPACKET *packet)
{   
  // The LED will toggle when a new packet is received
  //digitalWrite(LED, HIGH);
  //delay(1);
  //digitalWrite(LED, LOW);
  
 
  if (packet->length > 1) { 
     
   // Our source address
//     data_zero = packet->data[0];
//     data_one = packet->data[1];   // Self-incrementing value generated by the sender
//     data_two = packet->data[2];

    crc_t = packet->crc_ok;
    length_t = packet->length;
    rssi_t = packet->rssi;
    lqi_t = packet->lqi;
    destination_t = packet->data[0];
    for (i = 0; i <= length_t-1; i++){
    data_rec[i] = packet->data[i+1];
    }
    flag = 1;
  }
  
  /*
  if(data_one == 151){
  digitalWrite(LED_GREEN, HIGH);
  delay(1);
  digitalWrite(LED_GREEN, LOW);
  }*/
}

void PrintHex8(uint8_t *data, uint8_t length) // prints 8-bit data in hex with leading zeroes
{    
     char tmp[16];
       for (int i=0; i<length; i++) { 
         sprintf(tmp, "%.2X",data[i]); 
         Serial.print(tmp); Serial.print(" ");
       }
       //Serial.println("");
}

void clear_buffer(){
  for (i = 0; i <= 7; i++){
    data_rec[i] = 0;
  }
}
